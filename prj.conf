## CMakeLists.txt
```
cmake_minimum_required(VERSION 3.19)

set(TARGET_PLATFORM linux CACHE STRING "Platform to compile isere for")

# optimised with debug info unless asked otherwise; this applies to the engines and mbedTLS too
if(NOT CMAKE_BUILD_TYPE AND NOT CMAKE_CONFIGURATION_TYPES)
  set(CMAKE_BUILD_TYPE RelWithDebInfo CACHE STRING "Build type" FORCE)
endif()

# build configuration
option(DEBUG "Debug mode" OFF)
set(JS_RUNTIME quickjs CACHE STRING "JavaScript runtime") # quickjs (default), jerryscript

option(WITH_OTEL "OpenTelemetry Exporter enabled" OFF)
set(OTEL_HOST "127.0.0.1" CACHE STRING "OpenTelemetry Collector OTLP/HTTP host")
set(OTEL_PORT 4318 CACHE STRING "OpenTelemetry Collector OTLP/HTTP port")

# the application: one or more directories, each with a routes.json and its JS modules
set(ISERE_APP_DIRS "${CMAKE_CURRENT_SOURCE_DIR}/app" CACHE STRING "App directories to embed (;-separated)")

# platform-specific configuration
option(WITH_LWIP "Include LwIP" OFF)

include(portable/${TARGET_PLATFORM}/platform_features.cmake)

project(isere C CXX ASM)

# every path is absolute, so the build directory can be anywhere
set(ROOT ${CMAKE_CURRENT_SOURCE_DIR})
set(FREERTOS_DIR ${ROOT}/3rdparty/FreeRTOS)
set(QUICKJS_DIR ${ROOT}/3rdparty/quickjs)
set(JERRYSCRIPT_DIR ${ROOT}/3rdparty/jerryscript)
set(MBEDTLS_DIR ${ROOT}/3rdparty/mbedtls)
set(LWIP_DIR ${ROOT}/3rdparty/lwip)
set(NANOPB_DIR ${ROOT}/3rdparty/nanopb)
set(OTELPROTO_DIR ${ROOT}/3rdparty/opentelemetry-proto)

set(SOURCES )
set(LIBS )

list(APPEND SOURCES
  ${ROOT}/src/crypto.c
  ${ROOT}/src/engine.c
  ${ROOT}/src/fetch.c
  ${ROOT}/src/hooks.c
  ${ROOT}/src/http_parser.c
  ${ROOT}/src/httpd.c
  ${ROOT}/src/loop.c
  ${ROOT}/src/mem.c
  ${ROOT}/src/metrics.c
  ${ROOT}/src/internals/uv_poll.c
  ${ROOT}/portable/${TARGET_PLATFORM}/src/fs.c
  ${ROOT}/portable/${TARGET_PLATFORM}/src/logger.c
  ${ROOT}/portable/${TARGET_PLATFORM}/src/rtc.c
  ${ROOT}/portable/${TARGET_PLATFORM}/src/tcp.c
  ${ROOT}/portable/${TARGET_PLATFORM}/src/platform.c
  ${FREERTOS_DIR}/croutine.c
  ${FREERTOS_DIR}/event_groups.c
  ${FREERTOS_DIR}/list.c
  ${FREERTOS_DIR}/queue.c
  ${FREERTOS_DIR}/stream_buffer.c
  ${FREERTOS_DIR}/tasks.c
  ${FREERTOS_DIR}/timers.c
  ${CMAKE_CURRENT_BINARY_DIR}/app_bundle.c
)

include(portable/${TARGET_PLATFORM}/platform_sources.cmake OPTIONAL)

if(WITH_LWIP)
  set(LWIP_INCLUDE_DIRS
    ${LWIP_DIR}/src/include
    ${ROOT}/portable/${TARGET_PLATFORM}/include
  )
  include(${LWIP_DIR}/src/Filelists.cmake)
endif()

# the app bundle: routes, modules, config and the prelude, regenerated when any of them change
file(GLOB PRELUDE_PARTS CONFIGURE_DEPENDS ${ROOT}/src/prelude/*.js)
set(APP_DEPENDS ${ROOT}/src/prelude.js ${PRELUDE_PARTS} ${ROOT}/tools/bundle_app.cmake)
foreach(dir IN LISTS ISERE_APP_DIRS)
  file(GLOB app_files CONFIGURE_DEPENDS ${dir}/*)
  list(APPEND APP_DEPENDS ${app_files})
endforeach()
string(REPLACE ";" "|" APP_DIRS_ARG "${ISERE_APP_DIRS}")
add_custom_command(
  OUTPUT ${CMAKE_CURRENT_BINARY_DIR}/app_bundle.c
  COMMAND ${CMAKE_COMMAND} "-DAPP_DIRS=${APP_DIRS_ARG}" -DPRELUDE=${ROOT}/src/prelude.js
    -DOUTPUT=${CMAKE_CURRENT_BINARY_DIR}/app_bundle.c -P ${ROOT}/tools/bundle_app.cmake
  DEPENDS ${APP_DEPENDS}
  COMMENT "Bundling the app from ${ISERE_APP_DIRS}"
  VERBATIM
)

if(JS_RUNTIME STREQUAL quickjs)
  list(APPEND SOURCES
    ${QUICKJS_DIR}/quickjs.c
    ${QUICKJS_DIR}/dtoa.c
    ${QUICKJS_DIR}/libregexp.c
    ${QUICKJS_DIR}/libunicode.c
    ${ROOT}/src/runtimes/quickjs/vm.c
  )
elseif(JS_RUNTIME STREQUAL jerryscript)
  list(APPEND SOURCES
    ${ROOT}/src/runtimes/jerryscript/vm.c
    ${ROOT}/src/runtimes/jerryscript/jerry-port.c
  )
endif()

# mbedTLS: only the modules isere_mbedtls_config.h enables end up in the binary
file(GLOB MBEDTLS_SOURCES ${MBEDTLS_DIR}/library/*.c)
add_library(isere_mbedtls STATIC ${MBEDTLS_SOURCES})
target_include_directories(isere_mbedtls PUBLIC ${MBEDTLS_DIR}/include ${ROOT}/include)
target_compile_definitions(isere_mbedtls PUBLIC MBEDTLS_CONFIG_FILE="isere_mbedtls_config.h")
list(APPEND LIBS isere_mbedtls)

add_executable(isere ${SOURCES} ${ROOT}/src/main.c)

target_compile_definitions(isere PRIVATE
  ISERE_RUNTIME_NAME="${JS_RUNTIME}"
  ISERE_JS_STACK_SIZE=\(${ISERE_JS_STACK_KB}*1024\)
  __STDC_FORMAT_MACROS=1)

if(WITH_OTEL)
  target_sources(isere PRIVATE ${ROOT}/src/otel.c)
  target_compile_definitions(isere PRIVATE
    ISERE_WITH_OTEL
    ISERE_OTEL_HOST="${OTEL_HOST}"
    ISERE_OTEL_PORT=${OTEL_PORT})

  set(CMAKE_MODULE_PATH ${CMAKE_MODULE_PATH} ${NANOPB_DIR}/extra)
  find_package(Nanopb REQUIRED)
  set(PROTOC_OPTIONS --experimental_allow_proto3_optional)
  nanopb_generate_cpp(TARGET otelproto RELPATH ${OTELPROTO_DIR}
    ${OTELPROTO_DIR}/opentelemetry/proto/metrics/v1/metrics.proto
    ${OTELPROTO_DIR}/opentelemetry/proto/common/v1/common.proto
    ${OTELPROTO_DIR}/opentelemetry/proto/resource/v1/resource.proto)
  target_link_libraries(isere PRIVATE otelproto)
endif()

if(JS_RUNTIME STREQUAL quickjs)
  target_compile_definitions(isere PRIVATE ISERE_RUNTIME_QUICKJS)
elseif(JS_RUNTIME STREQUAL jerryscript)
  # one context per engine instance, switched by the binding
  set(JERRY_EXTERNAL_CONTEXT ON CACHE BOOL "" FORCE)
  set(JERRY_PROMISE_CALLBACK ON CACHE BOOL "" FORCE)
  set(JERRY_ERROR_MESSAGES ON CACHE BOOL "" FORCE)
  set(JERRY_MEM_STATS ON CACHE BOOL "" FORCE)
  # lets the handler deadline stop a script that never yields
  set(JERRY_VM_HALT ON CACHE BOOL "" FORCE)
  set(JERRY_LINE_INFO ON CACHE BOOL "" FORCE)
  # deep recursion raises a RangeError instead of overflowing the httpd task's stack
  set(JERRY_STACK_LIMIT ${ISERE_JS_STACK_KB} CACHE STRING "" FORCE)

  add_custom_target(amalgam)
  add_subdirectory(${JERRYSCRIPT_DIR}/jerry-core ${CMAKE_CURRENT_BINARY_DIR}/jerry-core)
  add_subdirectory(${JERRYSCRIPT_DIR}/jerry-ext ${CMAKE_CURRENT_BINARY_DIR}/jerry-ext)
  list(APPEND LIBS
    jerry-core
    jerry-ext
  )
  # src/runtimes/jerryscript/stack.c needs JerryScript's private headers
  add_library(isere_jerry_internal OBJECT ${ROOT}/src/runtimes/jerryscript/stack.c)
  target_link_libraries(isere_jerry_internal PRIVATE jerry-core)
  target_include_directories(isere_jerry_internal PRIVATE $<TARGET_PROPERTY:jerry-core,INCLUDE_DIRECTORIES>)
  target_sources(isere PRIVATE $<TARGET_OBJECTS:isere_jerry_internal>)
  target_compile_definitions(isere PRIVATE ISERE_RUNTIME_JERRYSCRIPT)
  target_include_directories(isere PRIVATE
    ${JERRYSCRIPT_DIR}/jerry-core/include
    ${JERRYSCRIPT_DIR}/jerry-ext/include
  )
endif()

find_package(Git REQUIRED)
execute_process(COMMAND ${GIT_EXECUTABLE} rev-parse --short HEAD
  WORKING_DIRECTORY ${ROOT} OUTPUT_VARIABLE COMMIT_ID OUTPUT_STRIP_TRAILING_WHITESPACE)
target_compile_definitions(isere PRIVATE _GNU_SOURCE CONFIG_VERSION="${COMMIT_ID}")

set(ISERE_BUILD_ID "${COMMIT_ID}" CACHE STRING "Build identifier served at /__version")
target_compile_definitions(isere PRIVATE ISERE_BUILD_ID="${ISERE_BUILD_ID}")

if(DEBUG)
  target_compile_options(isere PRIVATE -O0 -g)

  if(JS_RUNTIME STREQUAL jerryscript)
    target_compile_options(jerry-core PRIVATE -O0 -g)
    target_compile_options(jerry-ext PRIVATE -O0 -g)
  endif()
endif()

include(portable/${TARGET_PLATFORM}/platform_extras.cmake OPTIONAL)

target_include_directories(isere PRIVATE
  ${ROOT}/include
  ${ROOT}/portable/include
  ${ROOT}/portable/${TARGET_PLATFORM}/include
  ${FREERTOS_DIR}/include
  ${QUICKJS_DIR}
)

if(WITH_LWIP)
  target_include_directories(isere PRIVATE
    ${LWIP_DIR}/src/include
  )
  list(APPEND LIBS
    lwipallapps
    lwipcore
  )
  target_compile_definitions(isere PRIVATE ISERE_WITH_LWIP)
endif()

target_link_libraries(isere PRIVATE ${LIBS})
```

## west.yml
```
manifest:
  remotes:
    - name: zephyrproject-rtos
      url-base: https://github.com/zephyrproject-rtos

  projects:
    - name: zephyr
      remote: zephyrproject-rtos
      revision: main
      import:
        name-allowlist:
          - cmsis
          - cmsis_6
          - hal_rpi_pico
          - mbedtls
          - picolibc

    - name: zephyr-lang-rust
      remote: zephyrproject-rtos
      revision: main
      path: modules/lang/rust

  self:
    path: app
```

## prj.conf
```kconfig
# isere - Zephyr configuration
# Serverless platform for microcontrollers

# Rust support
CONFIG_RUST=y

# Logging
CONFIG_LOG=y
CONFIG_PRINTK=y
CONFIG_LOG_MODE_DEFERRED=y

# Main thread stack (needs headroom for QuickJS eval)
CONFIG_MAIN_STACK_SIZE=16384

# Heap for dynamic allocation (QuickJS + HTTP buffers)
# 128KB allows ~80KB for JS heap + 48KB for networking/buffers
CONFIG_HEAP_MEM_POOL_SIZE=131072

# Timers (for setTimeout/clearTimeout polyfills)
CONFIG_SYS_CLOCK_TICKS_PER_SEC=1000

# Networking is configured per-board in boards/*.conf
# (rpi_pico2: USB CDC-ECM, native_sim: TAP interface)
```

## boards/native_sim.conf
```kconfig
# Board-specific Kconfig for native_sim (development target)
#
# On native_sim, socket calls (socket/bind/listen/etc.) resolve to glibc's
# POSIX implementation — the server binds on the host network stack directly.
# This is fine for integration testing via localhost. Zephyr's own network
# stack (TAP/Ethernet) is exercised on real hardware (RP2350).

# Networking (enables Zephyr's networking subsystem for CONFIG_POSIX_API)
CONFIG_NETWORKING=y
CONFIG_NET_IPV4=y
CONFIG_NET_TCP=y
CONFIG_NET_UDP=y
CONFIG_NET_SOCKETS=y
CONFIG_POSIX_API=y

# Network logging
CONFIG_NET_LOG=y

# Network buffers
CONFIG_NET_PKT_RX_COUNT=16
CONFIG_NET_PKT_TX_COUNT=16
CONFIG_NET_BUF_RX_COUNT=32
CONFIG_NET_BUF_TX_COUNT=32
CONFIG_NET_BUF_DATA_SIZE=128
```

## boards/rpi_pico2_rp2350a_m33.conf
```kconfig
# Board-specific Kconfig for Raspberry Pi Pico 2
# USB CDC-ECM Ethernet networking

# FPU — RP2350 Cortex-M33 has hardware float
CONFIG_FPU=y

# USB device stack (new stack)
CONFIG_USB_DEVICE_STACK_NEXT=y
CONFIG_USBD_CDC_ECM_CLASS=y

# Networking
CONFIG_NETWORKING=y
CONFIG_NET_L2_ETHERNET=y
CONFIG_NET_IPV4=y
CONFIG_NET_TCP=y
CONFIG_NET_UDP=y
CONFIG_NET_SOCKETS=y
# POSIX API: provides unprefixed socket names (socket/bind/listen/accept/
# recv/send/close/poll/fcntl) and gettimeofday; replaces the removed
# NET_SOCKETS_POSIX_NAMES from older Zephyr
CONFIG_POSIX_API=y

# Network configuration
CONFIG_NET_CONFIG_SETTINGS=y
CONFIG_NET_CONFIG_MY_IPV4_ADDR="192.168.7.1"
CONFIG_NET_CONFIG_MY_IPV4_NETMASK="255.255.255.0"

# DHCP server so the host gets an IP automatically
CONFIG_NET_DHCPV4_SERVER=y

# Network buffers
CONFIG_NET_PKT_RX_COUNT=16
CONFIG_NET_PKT_TX_COUNT=16
CONFIG_NET_BUF_RX_COUNT=32
CONFIG_NET_BUF_TX_COUNT=32
CONFIG_NET_BUF_DATA_SIZE=128

# Network logging
CONFIG_NET_LOG=y

# Increase stack for USB
CONFIG_ISR_STACK_SIZE=2048
CONFIG_SYSTEM_WORKQUEUE_STACK_SIZE=2048
```

## boards/native_sim.overlay
```dts
/*
 * Device tree overlay for native_sim development target
 * Uses host networking via TAP interface
 */
```

## boards/rpi_pico2_rp2350a_m33.overlay
```dts
/*
 * Device tree overlay for Raspberry Pi Pico 2 (RP2350)
 * Enables USB CDC-ECM Ethernet networking
 */

/ {
	chosen {
		zephyr,console = &uart0;
		zephyr,shell-uart = &uart0;
	};
};

&zephyr_udc0 {
	cdc_ecm {
		compatible = "zephyr,cdc-ecm-ethernet";
		remote-mac = "00:00:5E:00:53:01";
	};
};
```

## src/main.c
```c
#include <string.h>
#include <stdio.h>
#include <stdlib.h>
#ifdef __linux__
#include <signal.h>
#endif

#include "FreeRTOS.h"
#include "task.h"

#include "isere.h"

#include "logger.h"
#include "mem.h"
#include "metrics.h"
#include "otel.h"
#include "httpd.h"
#include "platform.h"
#include "tcp.h"

static isere_httpd_t httpd;

#ifdef ISERE_WITH_OTEL
static isere_otel_t *__otel = NULL;
#endif /* ISERE_WITH_OTEL */

#ifdef __linux__
static void on_signal(int signum)
{
  // only async-signal-safe work here: the httpd task notices the flag and shuts down
  (void)signum;
  httpd.should_exit = 1;
#ifdef ISERE_WITH_OTEL
  if (__otel != NULL) {
    __otel->should_exit = 1;
  }
#endif /* ISERE_WITH_OTEL */
}
#endif

int main(void)
{
  platform_init();
  uint64_t boot_us = platform_now_us();
  isere_mem_init(platform_heap_size());

  isere_logger_t logger;
  memset(&logger, 0, sizeof(isere_logger_t));
  if (isere_logger_init(&logger) < 0) {
    fprintf(stderr, "Unable to initialize logger module");
    return EXIT_FAILURE;
  }

  isere_rtc_t rtc;
  memset(&rtc, 0, sizeof(isere_rtc_t));
  if (isere_rtc_init(&rtc) < 0) {
    logger.error(ISERE_LOG_TAG, "Unable to initialize rtc module");
    return EXIT_FAILURE;
  }

  isere_tcp_t tcp;
  memset(&tcp, 0, sizeof(isere_tcp_t));
  if (isere_tcp_init(&tcp) < 0) {
    logger.error(ISERE_LOG_TAG, "Unable to initialize tcp module");
    return EXIT_FAILURE;
  }

#ifdef ISERE_WITH_OTEL
  isere_otel_t otel;
  memset(&otel, 0, sizeof(isere_otel_t));
  if (isere_otel_init(&otel, &logger, &rtc) < 0) {
    logger.error(ISERE_LOG_TAG, "Unable to initialize otel module");
    return EXIT_FAILURE;
  }
  __otel = &otel;
#endif /* ISERE_WITH_OTEL */

  memset(&httpd, 0, sizeof(isere_httpd_t));
  if (isere_httpd_init(&httpd, &logger) < 0) {
    logger.error(ISERE_LOG_TAG, "Unable to initialize httpd module");
    return EXIT_FAILURE;
  }
  isere_metrics_mark_boot(boot_us);

#ifdef __linux__
  struct sigaction sa;
  memset(&sa, 0, sizeof(sa));
  sa.sa_handler = on_signal;
  sigaction(SIGINT, &sa, NULL);
  sigaction(SIGTERM, &sa, NULL);
#endif /* __linux__ */

  // doesn't return on Linux: the httpd task exits the process when it has shut down
  vTaskStartScheduler();

  isere_logger_deinit(&logger);
  return httpd.should_exit == 2 ? EXIT_SUCCESS : EXIT_FAILURE;
}
```

## include/FreeRTOSConfig.h
```c
/*
 * FreeRTOS V202112.00
 * Copyright (C) 2020 Amazon.com, Inc. or its affiliates.  All Rights Reserved.
 *
 * Permission is hereby granted, free of charge, to any person obtaining a copy of
 * this software and associated documentation files (the "Software"), to deal in
 * the Software without restriction, including without limitation the rights to
 * use, copy, modify, merge, publish, distribute, sublicense, and/or sell copies of
 * the Software, and to permit persons to whom the Software is furnished to do so,
 * subject to the following conditions:
 *
 * The above copyright notice and this permission notice shall be included in all
 * copies or substantial portions of the Software.
 *
 * THE SOFTWARE IS PROVIDED "AS IS", WITHOUT WARRANTY OF ANY KIND, EXPRESS OR
 * IMPLIED, INCLUDING BUT NOT LIMITED TO THE WARRANTIES OF MERCHANTABILITY, FITNESS
 * FOR A PARTICULAR PURPOSE AND NONINFRINGEMENT. IN NO EVENT SHALL THE AUTHORS OR
 * COPYRIGHT HOLDERS BE LIABLE FOR ANY CLAIM, DAMAGES OR OTHER LIABILITY, WHETHER
 * IN AN ACTION OF CONTRACT, TORT OR OTHERWISE, ARISING FROM, OUT OF OR IN
 * CONNECTION WITH THE SOFTWARE OR THE USE OR OTHER DEALINGS IN THE SOFTWARE.
 *
 * https://www.FreeRTOS.org
 * https://github.com/FreeRTOS
 *
 */
#ifndef FREERTOS_CONFIG_H
#define FREERTOS_CONFIG_H

/*-----------------------------------------------------------
* Application specific definitions.
*
* These definitions should be adjusted for your particular hardware and
* application requirements.
*
* THESE PARAMETERS ARE DESCRIBED WITHIN THE 'CONFIGURATION' SECTION OF THE
* FreeRTOS API DOCUMENTATION AVAILABLE ON THE FreeRTOS.org WEB SITE.  See
* https://www.FreeRTOS.org/a00110.html
*----------------------------------------------------------*/

#define configUSE_PREEMPTION                       1
#define configUSE_PORT_OPTIMISED_TASK_SELECTION    0
#define configUSE_IDLE_HOOK                        1
#define configUSE_TICK_HOOK                        1
#define configUSE_DAEMON_TASK_STARTUP_HOOK         1
#define configTICK_RATE_HZ                         ( 1000 )                  /* In this non-real time simulated environment the tick frequency has to be at least a multiple of the Win32 tick frequency, and therefore very slow. */
#define configMINIMAL_STACK_SIZE                   ( ( unsigned short ) 70 ) /* In this simulated case, the stack only has to hold one small structure as the real stack is part of the win32 thread. */
#define configTOTAL_HEAP_SIZE                      ( ( size_t ) ( 65 * 1024 ) )
#define configMAX_TASK_NAME_LEN                    ( 12 )
#define configUSE_TRACE_FACILITY                   1
#define configUSE_16_BIT_TICKS                     0
#define configIDLE_SHOULD_YIELD                    1
#define configUSE_MUTEXES                          1
#define configCHECK_FOR_STACK_OVERFLOW             0
#define configUSE_RECURSIVE_MUTEXES                1
#define configQUEUE_REGISTRY_SIZE                  20
#define configUSE_APPLICATION_TASK_TAG             1
#define configUSE_COUNTING_SEMAPHORES              1
#define configUSE_ALTERNATIVE_API                  0
#define configUSE_QUEUE_SETS                       1
#define configUSE_TASK_NOTIFICATIONS               1
#define configSUPPORT_STATIC_ALLOCATION            1
#define configSUPPORT_DYNAMIC_ALLOCATION           1

/* Software timer related configuration options.  The maximum possible task
 * priority is configMAX_PRIORITIES - 1.  The priority of the timer task is
 * deliberately set higher to ensure it is correctly capped back to
 * configMAX_PRIORITIES - 1. */
#define configUSE_TIMERS                           1
#define configTIMER_TASK_PRIORITY                  ( configMAX_PRIORITIES - 1 )
#define configTIMER_QUEUE_LENGTH                   20
#define configTIMER_TASK_STACK_DEPTH               ( configMINIMAL_STACK_SIZE * 2 )

#define configMAX_PRIORITIES                       ( 7 )

/* Run time stats gathering configuration options. */
unsigned long ulGetRunTimeCounterValue( void ); /* Prototype of function that returns run time counter. */
void vConfigureTimerForRunTimeStats( void );    /* Prototype of function that initialises the run time counter. */
#define configGENERATE_RUN_TIME_STATS             1

/* Co-routine related configuration options. */
#define configUSE_CO_ROUTINES                     0
#define configMAX_CO_ROUTINE_PRIORITIES           ( 2 )

/* This demo can use of one or more example stats formatting functions.  These
 * format the raw data provided by the uxTaskGetSystemState() function in to human
 * readable ASCII form.  See the notes in the implementation of vTaskList() within
 * FreeRTOS/Source/tasks.c for limitations. */
#define configUSE_STATS_FORMATTING_FUNCTIONS      0

/* Enables the test whereby a stack larger than the total heap size is
 * requested. */
#define configSTACK_DEPTH_TYPE                    uint32_t

/* Set the following definitions to 1 to include the API function, or zero
 * to exclude the API function.  In most cases the linker will remove unused
 * functions anyway. */
#define INCLUDE_vTaskPrioritySet                  1
#define INCLUDE_uxTaskPriorityGet                 1
#define INCLUDE_vTaskDelete                       1
#define INCLUDE_vTaskCleanUpResources             0
#define INCLUDE_vTaskSuspend                      1
#define INCLUDE_vTaskDelayUntil                   1
#define INCLUDE_vTaskDelay                        1
#define INCLUDE_uxTaskGetStackHighWaterMark       1
#define INCLUDE_uxTaskGetStackHighWaterMark2      1
#define INCLUDE_xTaskGetSchedulerState            1
#define INCLUDE_xTimerGetTimerDaemonTaskHandle    1
#define INCLUDE_xTaskGetIdleTaskHandle            1
#define INCLUDE_xTaskGetHandle                    1
#define INCLUDE_eTaskGetState                     1
#define INCLUDE_xSemaphoreGetMutexHolder          1
#define INCLUDE_xTimerPendFunctionCall            1
#define INCLUDE_xTaskAbortDelay                   1
#define INCLUDE_xTaskGetCurrentTaskHandle         1

#define configINCLUDE_MESSAGE_BUFFER_AMP_DEMO     0
#if ( configINCLUDE_MESSAGE_BUFFER_AMP_DEMO == 1 )
    extern void vGenerateCoreBInterrupt( void * xUpdatedMessageBuffer );
    #define sbSEND_COMPLETED( pxStreamBuffer )    vGenerateCoreBInterrupt( pxStreamBuffer )
#endif /* configINCLUDE_MESSAGE_BUFFER_AMP_DEMO */

extern void vAssertCalled( const char * const pcFileName,
                           unsigned long ulLine );

#endif /* FREERTOS_CONFIG_H */
```

## include/app.h
```c
#ifndef ISERE_APP_H_
#define ISERE_APP_H_

#ifdef __cplusplus
extern "C" {
#endif

#include <stdint.h>

// The application served by isère, embedded at build time from one or more app
// directories (see tools/bundle_app.cmake). Each directory has a routes.json
// and the JS modules it names.

typedef struct {
  const char *name;         // file name, also the import specifier ("./jwt.js" -> "jwt.js")
  const char *source;
  uint32_t source_len;
} isere_app_module_t;

typedef enum {
  ISERE_ROUTE_JS = 0,       // handled by a JS module's handler
  ISERE_ROUTE_STATIC,       // a file served as is, without touching a JS engine
} isere_route_kind_t;

typedef struct {
  const char *method;       // "GET", "POST", ... or "*" for any
  const char *path;         // exact path
  isere_route_kind_t kind;
  int module;               // ISERE_ROUTE_JS: index into modules
  const char *content_type; // ISERE_ROUTE_STATIC
  const char *data;         // ISERE_ROUTE_STATIC
  uint32_t data_len;
} isere_app_route_t;

typedef struct {
  const isere_app_module_t *modules;
  uint32_t num_modules;
  const isere_app_route_t *routes;
  uint32_t num_routes;
  const char *config;       // JSON object, merged from every app directory
  uint32_t config_len;
  const char *prelude;      // src/prelude.js, shared by both engines
  uint32_t prelude_len;
  const isere_app_module_t *prelude_parts;  // src/prelude/*.js, compiled on first use
  uint32_t num_prelude_parts;
} isere_app_t;

extern const isere_app_t isere_app;

#ifdef __cplusplus
}
#endif

#endif /* ISERE_APP_H_ */
```

## include/crypto.h
```c
#ifndef ISERE_CRYPTO_H_
#define ISERE_CRYPTO_H_

#ifdef __cplusplus
extern "C" {
#endif

#include <stddef.h>
#include <stdint.h>

// Native side of the crypto.subtle subset in src/prelude.js, backed by mbedTLS.
// Engine-neutral: the bindings only pass bytes in and out.

int isere_crypto_init(void);
void isere_crypto_deinit(void);

typedef enum { ISERE_KEY_RSA = 0, ISERE_KEY_EC_P256 } isere_key_kind_t;

// hash: 256, 384 or 512 (SHA-2)
// RSA: a = modulus n, b = exponent e; EC P-256: a = x, b = y. Both base64url, as in a JWK.
// For ECDSA the signature is r || s (the WebCrypto and JWS format).
// Returns 1 if the signature is valid, 0 if not, and <0 if the key is unusable (*error says why).
int isere_crypto_verify(isere_key_kind_t kind, int hash,
  const char *a, size_t a_len, const char *b, size_t b_len,
  const uint8_t *sig, size_t sig_len, const uint8_t *data, size_t data_len,
  const char **error);

// SHA-2 digest into out (64 bytes room); returns the digest length or <0
int isere_crypto_digest(int hash, const uint8_t *data, size_t len, uint8_t *out);

int isere_crypto_random(uint8_t *buf, size_t len);

// the DRBG, for TLS (an mbedtls_ctr_drbg_context *)
void *isere_crypto_drbg(void);

// base64url (or base64) without padding requirements; returns the decoded length or <0
int isere_base64url_decode(const char *in, size_t in_len, uint8_t *out, size_t out_cap);

// atob()/btoa() on "binary strings" (one byte per code point 0-255), which the
// engines take and give as UTF-8: these convert between that and raw bytes.
// atob: base64 text -> the UTF-8 form of the binary string; returns its length or <0
int isere_atob_utf8(const char *in, size_t in_len, char *out, size_t out_cap);
// btoa: the UTF-8 form of a binary string -> base64 text; returns its length, or <0
// if a code point is above 255
int isere_btoa_utf8(const char *in, size_t in_len, char *out, size_t out_cap);

#ifdef __cplusplus
}
#endif

#endif /* ISERE_CRYPTO_H_ */
```

## include/engine.h
```c
#ifndef ISERE_ENGINE_H_
#define ISERE_ENGINE_H_

#ifdef __cplusplus
extern "C" {
#endif

#include <stddef.h>
#include <stdint.h>

#include "app.h"
#include "request.h"
#include "metrics.h"
#include "loop.h"
#include "libuv/queue.h"

// ---------------------------------------------------------------------------
// What httpd sees: src/engine.c, the same for both engines.
//
// Warm mode (the default) keeps one engine instance for the whole process: every
// endpoint's module is evaluated once at boot and each request is a fresh call.
// Cold mode builds an instance for every request and frees it afterwards, which
// is how isère used to work; it stays for comparison and to test cleanup.
// ISERE_JS_MODE=cold|warm selects it on Linux.

int isere_engine_init(void);
void isere_engine_deinit(void);
const char *isere_engine_mode(void);
// runs the garbage collector of the warm instance (for /__metrics?gc=1)
void isere_engine_gc(void);
// bytes the warm instance's engine holds on its heap (0 in cold mode)
size_t isere_engine_heap_used(void);

// starts handling a JS route; the engine queues a response and calls
// isere_request_complete() later. Returns <0 if it could not start.
int isere_engine_dispatch(isere_request_t *req);

// ---------------------------------------------------------------------------
// What each engine binding provides (src/runtimes/<engine>/vm.c)

typedef struct js_vm js_vm_t;

// a stored reference to a JS function, owned by the binding
typedef void *js_ref_t;

// module: load only this app module (cold mode), or -1 for every routed module (warm)
js_vm_t *js_vm_new(int module, uint32_t phase_us[ISERE_PHASE_COUNT]);
// returns the number of objects still alive when the runtime was freed (QuickJS)
uint32_t js_vm_free(js_vm_t *vm);
// heap a module instance keeps (warm mode), measured while loading it
size_t js_vm_module_resident(js_vm_t *vm, int module);

// an instance the engine had to abandon (JerryScript ran out of its heap); src/engine.c
// fails its requests and replaces it
int js_vm_dead(js_vm_t *vm);

void js_vm_enter(js_vm_t *vm);
void js_vm_leave(js_vm_t *vm);

// builds the request object and calls the module's handler through the prelude
int js_vm_dispatch(js_vm_t *vm, isere_request_t *req);
// runs one pending promise job: 1 if one ran, 0 if none was pending, <0 on a fatal error
int js_vm_run_job(js_vm_t *vm);
int js_vm_call(js_vm_t *vm, js_ref_t fn);
void js_vm_release(js_vm_t *vm, js_ref_t fn);
void js_vm_gc(js_vm_t *vm);
// bytes the engine holds (QuickJS: its allocations; JerryScript: used part of its arena)
size_t js_vm_heap_used(js_vm_t *vm);

struct isere_fetch_result_s;
// hands a finished fetch (or its error) to the JS callback `fn`
void js_vm_fetch_done(js_vm_t *vm, js_ref_t fn, const struct isere_fetch_result_s *result);

// ---------------------------------------------------------------------------
// What src/engine.c provides to the bindings' natives

typedef struct {
  uint32_t id;
  js_vm_t *vm;
  uint32_t request_id;    // 0 when not started by a request
  js_ref_t fn;
  uint64_t interval_ms;   // 0 for setTimeout
  isere_timer_t timer;
  struct uv__queue node;
} js_timer_t;

uint32_t isere_js_set_timer(js_vm_t *vm, js_ref_t fn, uint64_t delay_ms, int repeat);
void isere_js_clear_timer(js_vm_t *vm, uint32_t id);

// the request whose code is running now, or NULL
isere_request_t *isere_js_current_request(void);
// looks up a request that is still waiting for its response
isere_request_t *isere_js_find_request(uint32_t id);

// polled by the bindings' interrupt handlers: stop the running script
int isere_js_should_interrupt(void);

// whether the prelude's parts are compiled on first use (ISERE_JS_LAZY, default on)
int isere_js_lazy(void);
// a prelude part by name, or NULL
const isere_app_module_t *isere_js_prelude_part(const char *name, size_t len);

// the app's config (JSON) and the overrides from ISERE_CONFIG (JSON or empty)
const char *isere_js_config(size_t *len);
const char *isere_js_config_overrides(size_t *len);

// console output from JS
void isere_js_log(int level, const char *msg, size_t len);

// calibration helpers (criterion 6)
void isere_js_spin(double ms);
void isere_js_alloc(size_t bytes);

#ifdef __cplusplus
}
#endif

#endif /* ISERE_ENGINE_H_ */
```

## include/fetch.h
```c
#ifndef ISERE_FETCH_H_
#define ISERE_FETCH_H_

#ifdef __cplusplus
extern "C" {
#endif

#include <stddef.h>
#include <stdint.h>

#include "engine.h"
#include "http_parser.h"

// Outbound HTTP and HTTPS for the JS fetch() polyfill. Requests run on the event
// loop like everything else, so a handler can fetch from the server it runs on
// (the JWKS endpoint on the same board) without blocking it.

typedef struct isere_fetch_result_s {
  const char *error;              // NULL on success
  int status;
  const char *buf;                // response head and body
  const http_header_t *headers;
  size_t num_headers;
  const char *body;
  size_t body_len;
} isere_fetch_result_t;

typedef struct {
  const char *method;
  size_t method_len;
  const char *url;
  size_t url_len;
  const char *const *header_names;   // flat lists of num_headers entries
  const size_t *header_name_lens;
  const char *const *header_values;
  const size_t *header_value_lens;
  size_t num_headers;
  const char *body;
  size_t body_len;
} isere_fetch_request_t;

void isere_fetch_init(void);
void isere_fetch_deinit(void);

// Starts a fetch for the running JS code; `fn` gets the result through
// js_vm_fetch_done(). Returns 0, or <0 if it could not start (fn is released).
int isere_fetch_start(js_vm_t *vm, const isere_fetch_request_t *request, js_ref_t fn);

// drop fetches started by a request or owned by an instance; their callbacks never run
void isere_fetch_cancel_request(uint32_t request_id);
void isere_fetch_cancel_vm(js_vm_t *vm);

// local TCP port of an outbound connection, so httpd can recognise connections
// this server opened to itself
int isere_fetch_is_own_port(uint16_t port);

// called by fetch when a request finishes (src/engine.c)
void isere_engine_fetch_done(js_vm_t *vm, uint32_t request_id, js_ref_t fn, const isere_fetch_result_t *result);

#ifdef __cplusplus
}
#endif

#endif /* ISERE_FETCH_H_ */
```

## include/fs.h
```c
#ifndef ISERE_FS_H_
#define ISERE_FS_H_

#ifdef __cplusplus
extern "C" {
#endif

#include "logger.h"

#define ISERE_FS_LOG_TAG "fs"

#define ISERE_FS_MAX_PATH 64

typedef int fs_file_t;

typedef struct {
  isere_logger_t *logger;
} isere_fs_t;

int fs_init(isere_fs_t *fs, isere_logger_t *logger);
void fs_deinit(isere_fs_t *fs);

int fs_open(isere_fs_t *fs, fs_file_t *file, const char *path, int flags);
int fs_close(isere_fs_t *fs, fs_file_t *file);

int fs_read(isere_fs_t *fs, fs_file_t *file, uint8_t *buf, size_t size);
int fs_write(isere_fs_t *fs, fs_file_t *file, uint8_t *buf, size_t size);

int fs_rewind(isere_fs_t *fs, fs_file_t *file);

#ifdef __cplusplus
}
#endif

#endif /* ISERE_FS_H_ */
```

## include/http_parser.h
```c
#ifndef ISERE_HTTP_PARSER_H_
#define ISERE_HTTP_PARSER_H_

#ifdef __cplusplus
extern "C" {
#endif

#include <stddef.h>
#include <stdint.h>

// A stateless HTTP/1.x head parser in the style of picohttpparser.
//
// It parses from the start of a buffer every time it's called and records every
// field as an {offset, len} span into that buffer, so nothing is copied and the
// buffer may be moved or grown between calls. Call it again whenever more
// bytes arrive; the head is small, so re-parsing costs little.

typedef struct {
  uint32_t off;
  uint32_t len;
} http_span_t;

typedef struct {
  http_span_t name;
  http_span_t value;
} http_header_t;

typedef struct {
  http_span_t method;
  http_span_t target;   // path and query as sent
  http_span_t path;
  http_span_t query;    // after '?', empty if none
  int minor_version;    // HTTP/1.<minor>
  size_t num_headers;
} http_request_head_t;

typedef struct {
  int minor_version;
  int status;
  http_span_t reason;
  size_t num_headers;
} http_response_head_t;

// return values of the parse functions; a positive value is the head's length in bytes
#define HTTP_PARSE_INCOMPLETE   (-2)  // need more bytes
#define HTTP_PARSE_ERROR        (-1)  // malformed: answer 400
#define HTTP_PARSE_TOO_MANY     (-3)  // `headers` is too small: grow it and call again

int http_parse_request(const char *buf, size_t len, http_request_head_t *req,
  http_header_t *headers, size_t max_headers);

int http_parse_response(const char *buf, size_t len, http_response_head_t *resp,
  http_header_t *headers, size_t max_headers);

// How the body of a message is delimited, decided from its headers.
typedef enum {
  HTTP_BODY_NONE = 0,
  HTTP_BODY_LENGTH,     // Content-Length
  HTTP_BODY_CHUNKED,    // Transfer-Encoding: chunked
  HTTP_BODY_UNTIL_CLOSE // responses only: read until the peer closes
} http_body_kind_t;

typedef struct {
  http_body_kind_t kind;
  uint64_t content_length;
  int keep_alive;
} http_framing_t;

// Returns 0, or HTTP_PARSE_ERROR for ambiguous or invalid framing: both
// Content-Length and Transfer-Encoding, more than one Content-Length, a
// Transfer-Encoding other than "chunked", or a malformed length.
int http_request_framing(const char *buf, const http_header_t *headers, size_t num_headers,
  int minor_version, http_framing_t *framing);
int http_response_framing(const char *buf, const http_header_t *headers, size_t num_headers,
  int minor_version, int status, int is_head_request, http_framing_t *framing);

// Checks a chunked body in buf[0, len). Returns HTTP_PARSE_INCOMPLETE,
// HTTP_PARSE_ERROR, or the number of bytes the encoded body occupies
// (including the last chunk and trailers). Leaves the buffer untouched.
int64_t http_chunked_length(const char *buf, size_t len);

// Decodes a complete chunked body in place, returning the decoded length.
// Only call it once http_chunked_length() has returned a length.
size_t http_chunked_decode(char *buf, size_t len);

// case-insensitive comparison of a span with a NUL-terminated literal (header names, tokens)
int http_span_equals(const char *buf, http_span_t span, const char *literal);
// exact comparison (methods and paths are case-sensitive)
int http_span_is(const char *buf, http_span_t span, const char *literal);

// first header named `name` (case-insensitive), or NULL
const http_header_t *http_find_header(const char *buf, const http_header_t *headers,
  size_t num_headers, const char *name);

#ifdef __cplusplus
}
#endif

#endif /* ISERE_HTTP_PARSER_H_ */
```

## include/httpd.h
```c
#ifndef ISERE_HTTPD_H_
#define ISERE_HTTPD_H_

#ifdef __cplusplus
extern "C" {
#endif

#include <stdint.h>

#include "logger.h"

#include "FreeRTOS.h"
#include "task.h"

#define ISERE_HTTPD_LOG_TAG "httpd"
#define ISERE_HTTPD_PORT 8080

// Each connection receives straight into its own buffer, which starts small and
// grows up to two budgets: one for the request head and one for the body.
// Exceeding them answers 431 and 413. Both can be overridden on Linux with
// ISERE_HEAD_BUDGET and ISERE_BODY_BUDGET.
#ifndef ISERE_HTTPD_HEAD_BUDGET
#define ISERE_HTTPD_HEAD_BUDGET (8 * 1024)
#endif
#ifndef ISERE_HTTPD_BODY_BUDGET
#define ISERE_HTTPD_BODY_BUDGET (16 * 1024)
#endif
#ifndef ISERE_HTTPD_INITIAL_BUFFER
#define ISERE_HTTPD_INITIAL_BUFFER 512
#endif

// an idle keep-alive connection is closed after this long
#ifndef ISERE_HTTPD_IDLE_TIMEOUT_MS
#define ISERE_HTTPD_IDLE_TIMEOUT_MS 5000
#endif
// a request head must arrive within this long of its first byte, or 408
#ifndef ISERE_HTTPD_HEAD_TIMEOUT_MS
#define ISERE_HTTPD_HEAD_TIMEOUT_MS 10000
#endif

// connections the server opens to itself (fetch to its own endpoints) may go
// over the connection limit by this many, so a full pool can't deadlock them
#ifndef ISERE_HTTPD_SELF_RESERVE
#define ISERE_HTTPD_SELF_RESERVE 2
#endif

#ifndef ISERE_HTTPD_TASK_STACK_SIZE
#define ISERE_HTTPD_TASK_STACK_SIZE  configMINIMAL_STACK_SIZE
#endif /* ISERE_HTTPD_TASK_STACK_SIZE */

typedef struct {
  volatile int should_exit;
  TaskHandle_t tsk;
  isere_logger_t *logger;
} isere_httpd_t;

int isere_httpd_init(isere_httpd_t *httpd, isere_logger_t *logger);
int isere_httpd_deinit(isere_httpd_t *httpd);

#ifdef __cplusplus
}
#endif

#endif /* ISERE_HTTPD_H_ */
```

## include/ini.h
```c
#ifndef ISERE_INI_H
#define ISERE_INI_H

#ifdef __cplusplus
extern "C" {
#endif

#include "isere.h"

#include "config.capnp.h"

#define INI_FILENAME "config.bin"
#define INI_MAX_CONFIG_FILE_SIZE 256

int isere_ini_init(isere_t *isere, isere_ini_t *ini);
int isere_ini_get_timeout(isere_ini_t *ini);
void isere_ini_deinit(isere_ini_t *ini);

#ifdef __cplusplus
}
#endif

#endif /* ISERE_INI_H */
```

## include/isere.h
```c
#ifndef ISERE_H_
#define ISERE_H_

#ifdef __cplusplus
extern "C" {
#endif

#include "platform.h"

#define ISERE_APP_NAME "isere"

#ifndef ISERE_APP_VERSION
#define ISERE_APP_VERSION "0.0.1"
#endif /* ISERE_APP_VERSION */

#define ISERE_LOG_TAG "isere"

#ifdef __cplusplus
}
#endif

#endif /* ISERE_H_ */
```

## include/isere_mbedtls_config.h
```c
#ifndef ISERE_MBEDTLS_CONFIG_H_
#define ISERE_MBEDTLS_CONFIG_H_

// mbedTLS for isère: JWT signature verification (crypto.subtle) and a TLS 1.2
// client for fetch(). Everything else is left out to keep the image small.

// allocations go through isère's accounting allocator (mbedtls_platform_set_calloc_free)
#define MBEDTLS_PLATFORM_C
#define MBEDTLS_PLATFORM_MEMORY

// inline assembly for bignum arithmetic where mbedTLS has it (aarch64, x86-64, Arm Thumb-2)
#define MBEDTLS_HAVE_ASM
#define MBEDTLS_BIGNUM_C
#define MBEDTLS_OID_C
#define MBEDTLS_ASN1_PARSE_C
#define MBEDTLS_ASN1_WRITE_C
#define MBEDTLS_BASE64_C
#define MBEDTLS_PEM_PARSE_C
#define MBEDTLS_ERROR_C

// hashes
#define MBEDTLS_MD_C
#define MBEDTLS_SHA1_C        /* some CA certificates are still signed with it */
#define MBEDTLS_SHA224_C
#define MBEDTLS_SHA256_C
#define MBEDTLS_SHA384_C
#define MBEDTLS_SHA512_C

// RS256 and ES256
#define MBEDTLS_RSA_C
#define MBEDTLS_PKCS1_V15
#define MBEDTLS_PKCS1_V21
#define MBEDTLS_ECP_C
#define MBEDTLS_ECDSA_C
#define MBEDTLS_ECDH_C
#define MBEDTLS_ECP_DP_SECP256R1_ENABLED
#define MBEDTLS_ECP_DP_SECP384R1_ENABLED
#define MBEDTLS_ECP_DP_CURVE25519_ENABLED
#define MBEDTLS_ECP_NIST_OPTIM

// certificates
#define MBEDTLS_PK_C
#define MBEDTLS_PK_PARSE_C
#define MBEDTLS_X509_USE_C
#define MBEDTLS_X509_CRT_PARSE_C

// randomness
#define MBEDTLS_CTR_DRBG_C
#define MBEDTLS_ENTROPY_C
#if !defined(__linux__)
// the board has no /dev/urandom; entropy comes from mbedtls_hardware_poll()
#define MBEDTLS_NO_PLATFORM_ENTROPY
#define MBEDTLS_ENTROPY_HARDWARE_ALT
#endif

// ciphers for TLS 1.2
#define MBEDTLS_CIPHER_C
#define MBEDTLS_AES_C
#define MBEDTLS_GCM_C
#define MBEDTLS_CHACHA20_C
#define MBEDTLS_POLY1305_C
#define MBEDTLS_CHACHAPOLY_C

// TLS 1.2 client with ECDHE key exchange
#define MBEDTLS_SSL_TLS_C
#define MBEDTLS_SSL_CLI_C
#define MBEDTLS_SSL_PROTO_TLS1_2
#define MBEDTLS_KEY_EXCHANGE_ECDHE_RSA_ENABLED
#define MBEDTLS_KEY_EXCHANGE_ECDHE_ECDSA_ENABLED
#define MBEDTLS_SSL_SERVER_NAME_INDICATION
#define MBEDTLS_SSL_EXTENDED_MASTER_SECRET
#define MBEDTLS_SSL_ENCRYPT_THEN_MAC

// servers may send full 16 KB records; requests are small
#define MBEDTLS_SSL_IN_CONTENT_LEN  16384
#define MBEDTLS_SSL_OUT_CONTENT_LEN 4096

#if defined(__linux__)
// certificate validity periods are checked against the clock
#define MBEDTLS_HAVE_TIME
#define MBEDTLS_HAVE_TIME_DATE
// the CA bundle is read from a file (ISERE_CA_FILE)
#define MBEDTLS_FS_IO
#endif

#endif /* ISERE_MBEDTLS_CONFIG_H_ */
```

## include/js.h
```c
#ifndef ISERE_JS_H_
#define ISERE_JS_H_

#ifdef __cplusplus
extern "C" {
#endif

#include "FreeRTOS.h"
#include "timers.h"

#ifdef ISERE_RUNTIME_QUICKJS
#include "quickjs.h"
#endif /* ISERE_RUNTIME_QUICKJS */

#ifdef ISERE_RUNTIME_JERRYSCRIPT
#include "jerryscript.h"
#endif /* ISERE_RUNTIME_JERRYSCRIPT */

#define ISERE_JS_LOG_TAG "js"

#define ISERE_JS_POLYFILLS_MAX_TIMERS 5

typedef struct {
  TimerHandle_t timer;
#ifdef ISERE_RUNTIME_QUICKJS
  JSContext *ctx;
  JSValue func;
#endif /* ISERE_RUNTIME_QUICKJS */
} polyfill_timer_t;

typedef struct {
  uint8_t initialized;
#ifdef ISERE_RUNTIME_QUICKJS
  JSRuntime *runtime;
  JSContext *context;
  JSValue future;
#endif /* ISERE_RUNTIME_QUICKJS */
#ifdef ISERE_RUNTIME_JERRYSCRIPT
  jerry_context_t *context;
#endif /* ISERE_RUNTIME_JERRYSCRIPT */
  polyfill_timer_t timers[ISERE_JS_POLYFILLS_MAX_TIMERS];
  void *opaque;
} isere_js_context_t;

typedef void * isere_js_t;

int isere_js_init(isere_js_t *js);
int isere_js_deinit(isere_js_t *js);
int isere_js_new_context(isere_js_t *js, isere_js_context_t *ctx);
int isere_js_free_context(isere_js_t *js, isere_js_context_t *ctx);
int isere_js_eval(
  isere_js_context_t *ctx,
  unsigned char *handler,
  unsigned int handler_len,
  const char *method,
  const char *path,
  const char *query,
  const char (*request_header_names)[],
  const char (*request_header_values)[],
  const uint32_t request_headers_len,
  const char *body);
int isere_js_poll(isere_js_context_t *ctx);

#ifdef __cplusplus
}
#endif

#endif /* ISERE_JS_H_ */
```
